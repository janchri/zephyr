## boards/silabs/dev_kits/pg23_pk2504a/board.yml
```yaml
board:
  name: pg23_pk2504a
  full_name: PG23 Pro Kit PK2504A Rev. A03
  vendor: silabs
  socs:
    - name: efm32pg23b310f512im48
```

## boards/silabs/dev_kits/xg23_pk2504a/xg23_pk2504a_defconfig
```kconfig
# SPDX-License-Identifier: Apache-2.0

CONFIG_ARM_MPU=y
CONFIG_CONSOLE=y
CONFIG_UART_CONSOLE=y
CONFIG_SERIAL=y
CONFIG_GPIO=y
CONFIG_HW_STACK_PROTECTION=y
CONFIG_REGULATOR=y
CONFIG_SOC_GECKO_EMU_DCDC=y
CONFIG_SOC_GECKO_EMU_DCDC_MODE_ON=y

## Optionally, deactivate the UART console and use RTT instead.
CONFIG_UART_CONSOLE=n
CONFIG_RTT_CONSOLE=y
CONFIG_USE_SEGGER_RTT=y
```

## soc/silabs/silabs_s2/xg23/Kconfig.defconfig
```kconfig
# Copyright (c) 2024 Yishai Jaffe
# Copyright (c) 2025 Christoph Jans
# SPDX-License-Identifier: Apache-2.0

if SOC_SERIES_EFR32ZG23 || SOC_SERIES_EFM32PG23

config NUM_IRQS
	# must be >= the highest interrupt number used
	default 75

config PM
	select UART_INTERRUPT_DRIVEN

config GPIO_GECKO
	default y

endif
```
