/*
 * Copyright (c) 2024 Yishai Jaffe
 * Copyright (c) 2025 Christoph Jans
 *
 * SPDX-License-Identifier: Apache-2.0
 */

#include <arm/armv8-m.dtsi>
#include <dt-bindings/gpio/gpio.h>
#include <dt-bindings/i2c/i2c.h>
#include <dt-bindings/adc/adc.h>
#include <dt-bindings/clock/silabs/xg23-clock.h>
#include <dt-bindings/dma/silabs/xg23-dma.h>
#include <silabs/xg23/xg23.dtsi>
#include <freq.h>

/ {
	soc {
		radio: radio@b0000000 {
			compatible = "silabs,series2-radio";
			reg = <0xb0000000 0x1000000>;
			interrupts = <31 0>, <32 0>, <33 0>, <34 0>, <35 0>, <36 0>,
				     <37 0>, <38 0>, <39 0>, <40 0>, <74 0>, <75 0>;
			interrupt-names = "agc", "bufc", "frc_pri", "frc", "modem", "protimer",
					  "rac_rsm", "rac_seq", "hostmailbox", "synth",
					  "rfeca0", "rfeca1";
			pa-initial-power-dbm = <10>;
			pa-ramp-time-us = <10>;
			pa-voltage-mv = <3300>;
			pa-subghz = "highest";
		};
	};
};
